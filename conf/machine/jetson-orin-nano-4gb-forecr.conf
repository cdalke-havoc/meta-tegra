## conf/machine/jetson-orin-nano-4gb-forecr.conf
```bitbake
#@TYPE: Machine
#@NAME: Nvidia Jetson Orin NX 4GB in ForeCR
#@DESCRIPTION: Nvidia Jetson Orin NX 4G module in P3768 carrier in ForeCR

MACHINEOVERRIDES =. "jetson-orin-nano-4g-forecr:"

TEGRA_FLASHVAR_MB2BCT_CFG ?= "tegra234-mb2-bct-misc-p3767-0000.dts"
TEGRA_FLASHVAR_PINMUX_CONFIG ?= "tegra234-mb1-bct-pinmux-p3767-dp-a03.dtsi"

require conf/machine/p3768-0000-p3767-0004.conf
```

## conf/machine/jetson-orin-nano-8gb-forecr.conf
```bitbake
#@TYPE: Machine
#@NAME: Nvidia Jetson Orin NX 8GB in ForeCR
#@DESCRIPTION: Nvidia Jetson Orin NX 8G module in P3768 carrier in ForeCR

MACHINEOVERRIDES =. "jetson-orin-nano-8g-forecr:"

PARTITION_LAYOUT_TEMPLATE_DEFAULT = "flash_t234_qspi.xml"
TEGRA_FLASHVAR_MB2BCT_CFG ?= "tegra234-mb2-bct-misc-p3767-0000.dts"
TEGRA_FLASHVAR_PINMUX_CONFIG ?= "tegra234-mb1-bct-pinmux-p3767-dp-a03.dtsi"

require conf/machine/p3768-0000-p3767-0003.conf
```
